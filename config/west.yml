## config/west.yml
```yaml
manifest:
  remotes:
    - name: zmkfirmware
      url-base: https://github.com/zmkfirmware
    - name: joelspadin
      url-base: https://github.com/joelspadin
    - name: urob
      url-base: https://github.com/urob
    - name: s6t
      url-base: https://github.com/s6t
  projects:
    - name: zmk
      remote: zmkfirmware
      revision: v0.3
      import: app/west.yml
    - name: zmk-shield-skeletyl
      remote: s6t
      revision: dongle
    - name: zmk-keymap
      remote: s6t
      revision: main
      import: true
  self:
    path: config
```
